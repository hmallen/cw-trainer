## esp32s3_wifi_companion/wifi_companion/main/Kconfig.projbuild
```kconfig
menu "WiFi Companion Configuration"

    config WIFI_SSID
        string "WiFi SSID"
        default "MyHomeWiFi"
    
    config WIFI_PASS
        string "WiFi Password"
        default "SecretPass123"
    
    endmenu
```
